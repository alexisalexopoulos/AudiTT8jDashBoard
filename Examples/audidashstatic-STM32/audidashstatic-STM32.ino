#include <Wire.h>
#include <OBD2UART.h>
#include<Arduino.h>
#include<U8g2lib.h>



COBD obd;

#ifdef U8X8_HAVE_HW_SPI
#include<SPI.h>
#endif
#ifdef U8X8_HAVE_HW_I2C
#include<Wire.h>
#endif

//Set parameters for the screen
U8G2_SH1106_128X64_NONAME_F_HW_I2C u8g2(U8G2_R0, /* reset=*/ U8X8_PIN_NONE);

//Define button and LED NONO
//const int  buttonPin = 2;    // the pin that the pushbutton is attached to
//const int ledPin = 12;       // the pin that the LED is attached to

//Define button and LED STM32
const int  buttonPin = PB3;    // the pin that the pushbutton is attached to
const int ledPin = PB1;       // the pin that the LED is attached to

// Define vars for screen rotation
int currentScreen = 0;   // counter for the number of button presses
int buttonState = 0;         // current state of the button
int lastButtonState = 0;     // previous state of the button


//Define common Gauge parameters
byte radius=23; //radius
byte percent=120; //needle percent
//Define parameters for left Gauge
byte Leftcenterx=32; //x center
byte Leftcentery=36; //y center
int n=(radius/100.00)*percent;
float Leftgs_rad=1.572;
float Leftge_rad=4.887;
//Define parameters for the Right Gauge
byte Rightcenterx=97; //x center
byte Rightcentery=36; //y center
float Rightgs_rad=4.712;
float Rightge_rad=1.396;


//Define the screen pages
int number_of_screens = 3;


// Define the bitmap
#define Audi_splash2_width 128
#define Audi_splash2_height 64
static const unsigned char Audi_splash2_bits[] PROGMEM = {
   0x00, 0x00, 0x00, 0x00, 0x00, 0x00, 0x00, 0x00, 0x00, 0x00, 0x00, 0x00,
   0x00, 0x00, 0x00, 0x00, 0x00, 0x00, 0x00, 0x00, 0x00, 0x00, 0x00, 0x00,
   0x00, 0x00, 0x00, 0x00, 0x00, 0x00, 0x00, 0x00, 0x00, 0x00, 0xf8, 0x1f,
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   0x03, 0x00, 0x00, 0x00 };

//define screen1 bitmap
#define gaugebmp_width 128
#define gaugebmp_height 64
static unsigned char gaugebmp[] = {
   0x00, 0x00, 0x00, 0x00, 0x00, 0x00, 0x00, 0x00, 0x00, 0x00, 0x00, 0x00,
   0x00, 0x00, 0x00, 0x00, 0x00, 0x00, 0x00, 0x00, 0x00, 0x00, 0x00, 0x00,
   0x00, 0x00, 0x00, 0x00, 0x00, 0x00, 0x00, 0x00, 0x00, 0x00, 0x00, 0x00,
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   0x00, 0x00, 0x00, 0x00 };

//Function to draw Gforce and Horizontal Bars
#define G_HBars_width 128
#define G_HBars_height 64
static const unsigned char G_HBars_bits[] PROGMEM = {
   0x00, 0x00, 0x00, 0x00, 0x00, 0x00, 0x00, 0x00, 0x00, 0x00, 0x00, 0x00,
   0x00, 0x00, 0x00, 0x00, 0x00, 0x00, 0x00, 0xfc, 0x7f, 0x00, 0x00, 0x00,
   0x00, 0xf8, 0xff, 0xff, 0xff, 0xff, 0xff, 0x3f, 0x00, 0x00, 0x80, 0xff,
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   0x00, 0x00, 0x00, 0x00 };

//Function to draw the bitmap
void drawpage1() {
 // graphic commands to redraw the complete screen should be placed here
  u8g2.drawXBMP( 0, 0, G_HBars_width, G_HBars_height, G_HBars_bits);
}


//Function to draw the bitmap
void drawGauge() {
 // graphic commands to redraw the complete screen should be placed here
  u8g2.drawXBMP( 0, 0, gaugebmp_width, gaugebmp_height , gaugebmp);
}

//Function to draw the bitmap
void drawSplash() {
 // graphic commands to redraw the complete screen should be placed here
  u8g2.drawXBMP( 0, 0, Audi_splash2_width, Audi_splash2_height, Audi_splash2_bits);
}

//Funtion reconnect when no OBD connection
void reconnect()
{
  //Turn on Led
  digitalWrite(ledPin, HIGH);
  //Print "Reconnecting"
      u8g2.clearBuffer();
      u8g2.setFont(u8g2_font_roentgen_nbp_t_all);
      u8g2.drawStr(0,15,"Reconnecting");
      u8g2.sendBuffer();
  for (uint16_t i = 0; !obd.init(); i++) {
    if (i == 5) {
      //Turn off Led
      digitalWrite(ledPin, LOW);
      delay(3000);
      u8g2.clear();
    }
  }
}

//Function to draw progress Bars
void drawProgressbar(int x,int y, int width,int height, int progress, int progressBarMaxValue)
{
  float progressbar = ((float)(width-4) / (progressBarMaxValue)) * progress;
  u8g2.drawFrame(x, y, width, height);
  u8g2.drawBox(x+2, y+2, progressbar , height-4 );

  }

/*Text block for vars
u8g2.setFont(u8g2_font_roentgen_nbp_tr);
u8g2.setCursor(0,50);
u8g2.print(value);*/


//Draw the screen
void DrawScreenStatic(int thescreen) {
  switch (thescreen) {
          case 0: {
        drawpage1();
        //Get the PIDS
        byte pids[3] = {PID_SPEED, PID_RPM,PID_ACC};
        int valuesStatic[sizeof(pids)] = {};
        valuesStatic[0] = 75;
        valuesStatic[1] = 15;
        valuesStatic[2] = 1;
        //print Text
        u8g2.setFont(u8g2_font_profont10_mf);
        u8g2.drawStr(65, 12, "SPEED");
        u8g2.drawStr(65, 30, "RPM");
        u8g2.drawStr(65, 49, "GFORCE");
        //SPEED
        u8g2.setFont(u8g2_font_profont15_mf);
        u8g2.setCursor(103, 14);
        u8g2.print((unsigned int)valuesStatic[0] % 1000);
        //RPM
        u8g2.setCursor(103, 33);
        u8g2.print((unsigned int)valuesStatic[1] % 10000);
        //GFORCE
        u8g2.setCursor(103, 52);
        u8g2.print((unsigned int)valuesStatic[1] % 10000);
      break;
    }
    case 1: {
        byte pids1[2] = {PID_COOLANT_TEMP, PID_INTAKE_TEMP};
        int valuesStatic1[sizeof(pids1)] = {};
        valuesStatic1[0] = 119;
        valuesStatic1[1] = 321;
        //Draw progress Bars
        //int pbarx = 5;
        //int pbary = 10;
        int pbarwidth = 100;
        int pbarheight = 10;
        drawProgressbar(14,10,pbarwidth,pbarheight,valuesStatic1[0], 120);
        drawProgressbar(14,40,pbarwidth,pbarheight,valuesStatic1[1], 1000);
        // Draw text
        u8g2.setFont(u8g2_font_profont10_mf);
        u8g2.drawStr(14, 8, "COOLANT");
        u8g2.drawStr(14, 38, "INTAKE");
        //Draw bar scale
        u8g2.drawStr(14, 28, "0");
        u8g2.drawStr(114, 28, "120");
        //Draw bar scale
        u8g2.drawStr(10, 58, "-20");
        u8g2.drawStr(114, 58, "100");
        /*u8g2.setFont(u8g2_font_profont17_mf);
        u8g2.setCursor(50, 20);
        u8g2.print(valuesStatic1[0]);
        u8g2.setCursor(50, 40);
        u8g2.print(valuesStatic1[1]);
        u8g2.setFont(u8g2_font_profont17_mf);
        u8g2.drawStr(0, 60, "speed");
        u8g2.setCursor(45, 55);
        u8g2.print((unsigned int)valuesStatic1[0] % 1000);
        u8g2.drawStr(32, 20, "RPM");
        u8g2.setCursor(32, 40);
        u8g2.print((unsigned int)valuesStatic1[1] % 10000);*/
      break;
    }
    case 2: {
        byte pids2[2] = {PID_FUEL_LEVEL, PID_ENGINE_TORQUE_PERCENTAGE};
        int valuesStatic2[sizeof(pids2)] = {};
        valuesStatic2[0] = 10;
        valuesStatic2[1] = 100;
        // we weten welke pids we gaan ophalen
        //u8g2.setFont(u8g2_font_profont17_mf);
        u8g2.drawStr(0, 20, "Fuel");
        u8g2.setCursor(50, 20);
        u8g2.print(valuesStatic2[0]);
        u8g2.drawStr(0, 40, "MEM");
      break;
    }
  }
}


void setup()
{
  //Init ledPin as output
  pinMode(ledPin, OUTPUT);
  //Init Screen
  u8g2.begin();
  delay(200);
   //Init OBD UART
  //obd.begin();
  //Turn on Led
  digitalWrite(ledPin, HIGH);
  // Drawing the splash screen
  /*u8g2.firstPage();
    do {
        drawSplash();
    } while( u8g2.nextPage() ); */
  delay(2000);
 //Connect to OBD
  //while (!obd.init());
  //Turn of ledPin
  digitalWrite(ledPin, LOW);
  //Clear screen and go to loop
  u8g2.clear();
}

void loop()
{


  // read the pushbutton input pin:
  buttonState = digitalRead(buttonPin);

  // compare the buttonState to its previous state
  if (buttonState != lastButtonState) {
    // if the state has changed, increment the counter
    if (buttonState == HIGH) {
      // if the current state is HIGH then the button went from off to on:
      currentScreen++;
      currentScreen = currentScreen % number_of_screens;
      // Delay a little bit to avoid bouncing
      delay(50);
      u8g2.clear();
    }
  }
// save the current state as the last state, for next time through the loop
  lastButtonState = buttonState;

  //Draw the screens

  u8g2.clearBuffer();
  DrawScreenStatic(currentScreen);
  u8g2.sendBuffer();


//Reconnect if no connection
  if (obd.errors >= 2) {
      delay(2000);
      reconnect();
      setup();
  }
}
